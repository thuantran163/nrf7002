## nrf7002_edge_impulse_test/SPI_sample/build/Kconfig/Kconfig.modules
```kconfig
menu "nrf (/home/thuantran/ncs/toolchains/nrf)"
osource "/home/thuantran/ncs/toolchains/nrf/Kconfig.nrf"
config ZEPHYR_NRF_MODULE
	bool
	default y
endmenu
menu "mcuboot (/home/thuantran/ncs/toolchains/bootloader/mcuboot)"
osource "$(ZEPHYR_MCUBOOT_KCONFIG)"
config ZEPHYR_MCUBOOT_MODULE
	bool
	default y
endmenu
menu "mbedtls (/home/thuantran/ncs/toolchains/modules/crypto/mbedtls)"
osource "$(ZEPHYR_MBEDTLS_KCONFIG)"
config ZEPHYR_MBEDTLS_MODULE
	bool
	default y
endmenu
menu "trusted-firmware-m (/home/thuantran/ncs/toolchains/modules/tee/tf-m/trusted-firmware-m)"
osource "$(ZEPHYR_TRUSTED_FIRMWARE_M_KCONFIG)"
config ZEPHYR_TRUSTED_FIRMWARE_M_MODULE
	bool
	default y
endmenu
config ZEPHYR_PSA_ARCH_TESTS_MODULE
   bool
   default y
menu "cjson (/home/thuantran/ncs/toolchains/modules/lib/cjson)"
osource "$(ZEPHYR_CJSON_KCONFIG)"
config ZEPHYR_CJSON_MODULE
	bool
	default y
endmenu
menu "azure-sdk-for-c (/home/thuantran/ncs/toolchains/modules/lib/azure-sdk-for-c)"
osource "$(ZEPHYR_AZURE_SDK_FOR_C_KCONFIG)"
config ZEPHYR_AZURE_SDK_FOR_C_MODULE
	bool
	default y
endmenu
menu "cirrus-logic (/home/thuantran/ncs/toolchains/modules/hal/cirrus-logic)"
osource "/home/thuantran/ncs/toolchains/modules/hal/cirrus-logic/Kconfig"
config ZEPHYR_CIRRUS_LOGIC_MODULE
	bool
	default y
endmenu
menu "openthread (/home/thuantran/ncs/toolchains/modules/lib/openthread)"
osource "$(ZEPHYR_OPENTHREAD_KCONFIG)"
config ZEPHYR_OPENTHREAD_MODULE
	bool
	default y
endmenu
menu "memfault-firmware-sdk (/home/thuantran/ncs/toolchains/modules/lib/memfault-firmware-sdk)"
osource "/home/thuantran/ncs/toolchains/modules/lib/memfault-firmware-sdk/ports/zephyr/Kconfig"
config ZEPHYR_MEMFAULT_FIRMWARE_SDK_MODULE
	bool
	default y
endmenu
menu "canopennode (/home/thuantran/ncs/toolchains/modules/lib/canopennode)"
osource "$(ZEPHYR_CANOPENNODE_KCONFIG)"
config ZEPHYR_CANOPENNODE_MODULE
	bool
	default y
endmenu
menu "chre (/home/thuantran/ncs/toolchains/modules/lib/chre)"
osource "/home/thuantran/ncs/toolchains/modules/lib/chre/platform/zephyr/Kconfig"
config ZEPHYR_CHRE_MODULE
	bool
	default y
endmenu
menu "lz4 (/home/thuantran/ncs/toolchains/modules/lib/lz4)"
osource "$(ZEPHYR_LZ4_KCONFIG)"
config ZEPHYR_LZ4_MODULE
	bool
	default y
endmenu
menu "nanopb (/home/thuantran/ncs/toolchains/modules/lib/nanopb)"
osource "$(ZEPHYR_NANOPB_KCONFIG)"
config ZEPHYR_NANOPB_MODULE
	bool
	default y
endmenu
config ZEPHYR_TF_M_TESTS_MODULE
   bool
   default y
menu "zscilib (/home/thuantran/ncs/toolchains/modules/lib/zscilib)"
osource "/home/thuantran/ncs/toolchains/modules/lib/zscilib/Kconfig.zscilib"
config ZEPHYR_ZSCILIB_MODULE
	bool
	default y
endmenu
menu "cmsis (/home/thuantran/ncs/toolchains/modules/hal/cmsis)"
osource "$(ZEPHYR_CMSIS_KCONFIG)"
config ZEPHYR_CMSIS_MODULE
	bool
	default y
endmenu
menu "cmsis-dsp (/home/thuantran/ncs/toolchains/modules/lib/cmsis-dsp)"
osource "$(ZEPHYR_CMSIS_DSP_KCONFIG)"
config ZEPHYR_CMSIS_DSP_MODULE
	bool
	default y
endmenu
menu "cmsis-nn (/home/thuantran/ncs/toolchains/modules/lib/cmsis-nn)"
osource "$(ZEPHYR_CMSIS_NN_KCONFIG)"
config ZEPHYR_CMSIS_NN_MODULE
	bool
	default y
endmenu
menu "fatfs (/home/thuantran/ncs/toolchains/modules/fs/fatfs)"
osource "$(ZEPHYR_FATFS_KCONFIG)"
config ZEPHYR_FATFS_MODULE
	bool
	default y
endmenu
menu "hal_nordic (/home/thuantran/ncs/toolchains/modules/hal/nordic)"
osource "$(ZEPHYR_HAL_NORDIC_KCONFIG)"
config ZEPHYR_HAL_NORDIC_MODULE
	bool
	default y
endmenu
config ZEPHYR_ST_MODULE
   bool
   default y
config ZEPHYR_HAL_WURTHELEKTRONIK_MODULE
   bool
   default y
config ZEPHYR_LIBMETAL_MODULE
   bool
   default y
menu "liblc3 (/home/thuantran/ncs/toolchains/modules/lib/liblc3)"
osource "$(ZEPHYR_LIBLC3_KCONFIG)"
config ZEPHYR_LIBLC3_MODULE
	bool
	default y
endmenu
menu "littlefs (/home/thuantran/ncs/toolchains/modules/fs/littlefs)"
osource "$(ZEPHYR_LITTLEFS_KCONFIG)"
config ZEPHYR_LITTLEFS_MODULE
	bool
	default y
endmenu
menu "loramac-node (/home/thuantran/ncs/toolchains/modules/lib/loramac-node)"
osource "$(ZEPHYR_LORAMAC_NODE_KCONFIG)"
config ZEPHYR_LORAMAC_NODE_MODULE
	bool
	default y
endmenu
menu "lvgl (/home/thuantran/ncs/toolchains/modules/lib/gui/lvgl)"
osource "/home/thuantran/ncs/toolchains/modules/lib/gui/lvgl/Kconfig"
config ZEPHYR_LVGL_MODULE
	bool
	default y
endmenu
config ZEPHYR_MIPI_SYS_T_MODULE
   bool
   default y
config ZEPHYR_NRF_HW_MODELS_MODULE
   bool
   default y
config ZEPHYR_OPEN_AMP_MODULE
   bool
   default y
menu "picolibc (/home/thuantran/ncs/toolchains/modules/lib/picolibc)"
osource "/home/thuantran/ncs/toolchains/modules/lib/picolibc/zephyr/Kconfig"
config ZEPHYR_PICOLIBC_MODULE
	bool
	default y
endmenu
menu "segger (/home/thuantran/ncs/toolchains/modules/debug/segger)"
osource "$(ZEPHYR_SEGGER_KCONFIG)"
config ZEPHYR_SEGGER_MODULE
	bool
	default y
endmenu
config ZEPHYR_TINYCRYPT_MODULE
   bool
   default y
menu "uoscore-uedhoc (/home/thuantran/ncs/toolchains/modules/lib/uoscore-uedhoc)"
osource "$(ZEPHYR_UOSCORE_UEDHOC_KCONFIG)"
config ZEPHYR_UOSCORE_UEDHOC_MODULE
	bool
	default y
endmenu
menu "zcbor (/home/thuantran/ncs/toolchains/modules/lib/zcbor)"
osource "$(ZEPHYR_ZCBOR_KCONFIG)"
config ZEPHYR_ZCBOR_MODULE
	bool
	default y
endmenu
menu "nrfxlib (/home/thuantran/ncs/toolchains/nrfxlib)"
osource "/home/thuantran/ncs/toolchains/nrfxlib/Kconfig.nrfxlib"
config ZEPHYR_NRFXLIB_MODULE
	bool
	default y
endmenu
menu "connectedhomeip (/home/thuantran/ncs/toolchains/modules/lib/matter)"
osource "/home/thuantran/ncs/toolchains/modules/lib/matter/config/nrfconnect/chip-module/Kconfig"
config ZEPHYR_CONNECTEDHOMEIP_MODULE
	bool
	default y
endmenu
```

## nrf7002_edge_impulse_test/SPI_sample/build/Kconfig/Kconfig.shield.defconfig
```kconfig
osource "/workspace/.emotiv/nrfconnect/v2.9.0-nRF54H20-rc1/nrf/boards/shields/*/Kconfig.defconfig"
```

## nrf7002_edge_impulse_test/SPI_sample/build/Kconfig/Kconfig.sysbuild.modules
```kconfig
menu "nrf (/root/ncs/nrf)"
osource "/root/ncs/nrf/sysbuild/Kconfig.sysbuild"
config ZEPHYR_NRF_MODULE
	bool
	default y
endmenu
```

## nrf7002_edge_impulse_test/SPI_sample/build/Kconfig/arch/Kconfig
```kconfig
# Load Zephyr Arch Kconfig descriptions.
osource "/workspace/.emotiv/nrfconnect/v2.9.0-nRF54H20-rc1/zephyr/arch/x86/Kconfig"
osource "/workspace/.emotiv/nrfconnect/v2.9.0-nRF54H20-rc1/zephyr/arch/xtensa/Kconfig"
osource "/workspace/.emotiv/nrfconnect/v2.9.0-nRF54H20-rc1/zephyr/arch/sparc/Kconfig"
osource "/workspace/.emotiv/nrfconnect/v2.9.0-nRF54H20-rc1/zephyr/arch/riscv/Kconfig"
osource "/workspace/.emotiv/nrfconnect/v2.9.0-nRF54H20-rc1/zephyr/arch/posix/Kconfig"
osource "/workspace/.emotiv/nrfconnect/v2.9.0-nRF54H20-rc1/zephyr/arch/nios2/Kconfig"
osource "/workspace/.emotiv/nrfconnect/v2.9.0-nRF54H20-rc1/zephyr/arch/mips/Kconfig"
osource "/workspace/.emotiv/nrfconnect/v2.9.0-nRF54H20-rc1/zephyr/arch/arm64/Kconfig"
osource "/workspace/.emotiv/nrfconnect/v2.9.0-nRF54H20-rc1/zephyr/arch/arm/Kconfig"
osource "/workspace/.emotiv/nrfconnect/v2.9.0-nRF54H20-rc1/zephyr/arch/arc/Kconfig"
```

## nrf7002_edge_impulse_test/SPI_sample/build/Kconfig/boards/Kconfig.defconfig
```kconfig
# Load Zephyr board defconfig descriptions.
osource "/workspace/.emotiv/nrfconnect/v2.8.0/zephyr/boards/nordic/nrf54h20dk/Kconfig.defconfig"
```

## nrf7002_edge_impulse_test/SPI_sample/build/Kconfig/boards/Kconfig.nrf7002dk
```kconfig
# Load board Kconfig descriptions.
osource "/workspace/.emotiv/nrfconnect/v2.9.0-nRF54H20-rc1/zephyr/boards/nordic/nrf7002dk/Kconfig.nrf7002dk"
```

## nrf7002_edge_impulse_test/SPI_sample/build/SPI_sample/Kconfig/Kconfig.shield
```kconfig
osource "/workspace/.emotiv/nrfconnect/v2.8.0/nrf/boards/shields/*/Kconfig.shield"
```

## nrf7002_edge_impulse_test/SPI_sample/build/SPI_sample/Kconfig/arch/Kconfig
```kconfig
# Load Zephyr Arch Kconfig descriptions.
osource "/workspace/.emotiv/nrfconnect/v2.8.0/zephyr/arch/x86/Kconfig"
osource "/workspace/.emotiv/nrfconnect/v2.8.0/zephyr/arch/xtensa/Kconfig"
osource "/workspace/.emotiv/nrfconnect/v2.8.0/zephyr/arch/sparc/Kconfig"
osource "/workspace/.emotiv/nrfconnect/v2.8.0/zephyr/arch/riscv/Kconfig"
osource "/workspace/.emotiv/nrfconnect/v2.8.0/zephyr/arch/posix/Kconfig"
osource "/workspace/.emotiv/nrfconnect/v2.8.0/zephyr/arch/nios2/Kconfig"
osource "/workspace/.emotiv/nrfconnect/v2.8.0/zephyr/arch/mips/Kconfig"
osource "/workspace/.emotiv/nrfconnect/v2.8.0/zephyr/arch/arm64/Kconfig"
osource "/workspace/.emotiv/nrfconnect/v2.8.0/zephyr/arch/arm/Kconfig"
osource "/workspace/.emotiv/nrfconnect/v2.8.0/zephyr/arch/arc/Kconfig"
```

## nrf7002_edge_impulse_test/blinky/build/Kconfig/Kconfig.sysbuild.modules
```kconfig
menu "nrf (/home/thuantran/ncs/v2.6.2/nrf)"
osource "/home/thuantran/ncs/v2.6.2/nrf/sysbuild/Kconfig.sysbuild"
config ZEPHYR_NRF_MODULE
	bool
	default y
endmenu
```
